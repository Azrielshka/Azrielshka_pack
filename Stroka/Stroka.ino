#include <LiquidCrystal_I2C.h>    // библиотека
LiquidCrystal_I2C lcd(0x27,16,2); //инициализация LCD дисплея, задание параметров (кол-во строк и символов);

bool flag = false;
void setup() {
  lcd.init();                      // инициализация LCD дисплея
  lcd.backlight();                 // включение подстветки
  lcd.setCursor(0,0);              //установка курсора на заданную позицию;
  lcd.print("Hello");              // Print a message to the LCD.
  
}

void loop() {
   if (flag == false){
   for (int i = 0; i <16 ; i++) {
    lcd.scrollDisplayRight();  // прокрутка содержимого дисплея на 1 позицию вправо;
      delay(500);
   } 
   flag = true;
   }
   else {for (int i = 0; i <21 ; i++) {
    lcd.scrollDisplayRight();  
      delay(500);
   } }
   for (int i = 0; i < 19; i++){
    lcd.scrollDisplayRight();  
   }
 }
 
/*
 *Команды библиотеки LiquidCrystal_I2C.h*
name.init() // инициализация LCD дисплея
name.clear()  // Очистка дисплея с установкой курсора в положение 0,0.
name.home()   // Установка курсора в позицию 0,0. Работает как функция setCursor(0,0);
name.noDisplay() // Выключает дисплей.Данные на дисплее не будут отображаться до вызова функции display, но и не сотрутся из памяти ОЗУ, а после вызова функции display, опять будут отображаться.
name.display()  // Включает дисплей после того как он был выключен функцией noDisplay.
name.noBlink()   //Выключение мигающего курсора.
name.blink()    //Включение мигающего курсора.
name.noCursor() // Выключение подчеркивания курсора.
name.cursor     // Включение подчеркивания курсора.
name.scrollDisplayLeft()  // Сдвигает координаты дисплея на один столбец вправо.
Постоянный вызов данной функции создаст эффект бегущей строки.
Координаты сдвигаются как для имеющейся на дисплее информации, так и для той, которая будет выведена после.
name.scrollDisplayRight () // Сдвигает координаты дисплея на один столбец влево.
Постоянный вызов данной функции создаст эффект бегущей строки.
Координаты сдвигаются как для имеющейся на дисплее информации, так и для той, которая будет выведена после.
name.leftToRight()  // Указывает, что после каждого нового символа, положение курсора должно сдвигаться на один столбец вправо.
name.rightToLeft()  // Указывает, что после каждого нового символа, положение курсора должно сдвигаться на один столбец влево.
name.shiftIncrement  
name.shiftDecrement  
name.noBacklight     // Выключение подсветки дисплея.
name.backlight       // Включение подсветки дисплея.
name.autoscroll()    // Указывает, что в дальнейшем, текст нужно выравнивать по правому краю от изначальной позиции курсора.
name.noAutoscroll()  // Указывает, что в дальнейшем, текст нужно выравнивать по левому краю от изначальной позиции курсора.
name.createChar(num,array) // Запись пользовательского символа в CGRAM дисплея под указанным номером. num: номер под которым будет записан символ (от 1 до 7).
array: массив представляющий записываемый символ.
name.setCursor(col,row) // Установка курсора в указанную позицию.
name.print // Вывод текста, символов или цифр на экран дисплея.
name.blink_on
name.blink_off
name.cursor_on
name.cursor_off
name.setBacklight(flag)  // Управление подсветкой (вместо функций noBacklight и backlight).
name.load_custom_character 
name.printstr
*/
